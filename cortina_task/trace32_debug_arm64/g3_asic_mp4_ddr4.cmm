; --------------------------------------------------------------------------------------------------
; @Title: Startup script for the G3 FPGA board
; @Description: This script configures the base addresses for debug and attaches to the core
; @Copyright: (C) 2015 Cortina Access
; --------------------------------------------------------------------------------------------------
; $Id: $
;
; NOTE: Interrupts are disabled with SYStem.Option IMASKASM and IMASKHLL per default
;

; G3 FPGA Configuration:
; * 4x Cortex-A53

//--------------------------------------------------------------------------------------------------
// Configuration

SYStem.RESet
SYStem.CPU CORTEXA53

SYStem.Option EnReset off

SYStem.CONFIG CORENUMBER 4.
;SYStem.CONFIG CORENUMBER 2.

  CORE.ASSIGN 1. 2. 3. 4.
  ;CORE.ASSIGN 1. 2.

//
// Cortex-A53 | debug      | CTI        | PMU        | trace
// -----------+------------+------------+------------+------------
//   core 0   | 0x80410000 | 0x80420000 | 0x80430000 | 0x80440000   
//   core 1   | 0x80510000 | 0x80520000 | 0x80530000 | 0x80540000
//   core 2   | 0x80610000 | 0x80620000 | 0x80630000 | 0x80640000   
//   core 3   | 0x80710000 | 0x80720000 | 0x80730000 | 0x80740000   
//
// Cortex-A53 ROM-Table: 0x80400000
//

// Access port numbers are
SYStem.CONFIG APBACCESSPORT 1.
SYStem.CONFIG DEBUGACCESSPORT 0.          ;set to 0 to work
SYStem.CONFIG AXIACCESSPORT 0.
SYStem.CONFIG MEMORYACCESSPORT 0.

// Pre/Post settings
;SYStem.CONFIG DAPIRPRE 4.
;SYStem.CONFIG DAPDRPRE 1.
;SYStem.CONFIG DAPIRPOST 0.
;SYStem.CONFIG DAPDRPOST 0.

// Assignment:  MP4
SYStem.CONFIG COREDEBUG BASE DAP:0x80410000 DAP:0x80510000 DAP:0x80610000 DAP:0x80710000
SYStem.CONFIG CTI BASE DAP:0x80420000 DAP:0x80520000 DAP:0x80620000 DAP:0x80720000
SYStem.CONFIG BMC BASE DAP:0x80430000 DAP:0x80530000 DAP:0x80630000 DAP:0x80730000
SYStem.CONFIG ETM BASE DAP:0x80440000 DAP:0x80540000 DAP:0x80640000 DAP:0x80740000

// Assignment:  MP2
;SYStem.CONFIG COREDEBUG BASE DAP:0x80410000 DAP:0x80510000
;SYStem.CONFIG CTI BASE DAP:0x80420000 DAP:0x80520000
;SYStem.CONFIG BMC BASE DAP:0x80430000 DAP:0x80530000
;SYStem.CONFIG ETM BASE DAP:0x80440000 DAP:0x80540000

//--------------------------------------------------------------------------------------------------
// Attach

  // Finally attach to the target
  ;SYStem.Mode Attach
  SYStem.Up
    
; if run()
; Break

; Enable DDR_SCH FPGA mode
data.set 0xf4328864 %l 0x01b74020 ;
;data.set 0xf432400c %l 0x0000f600 

;load images
;d.load.binary Q:\G3\g3-otp\build\g3_fpga\release\fip.bin 0x8000000 /verify
;d.load.binary  Q:\G3\g3-otp\build\g3_fpga\release\bl1.bin 0xfffc0000
;d.load.elf  Q:\G3\g3-otp\build\g3_fpga\release\bl1\bl1.elf /nocode /strippart "/space/" /path "Q:\"
;d.load.elf  Q:\G3\g3-otp\build\g3_fpga\release\bl2\bl2.elf /nocode /strippart "/space/" /path "Q:\"
;d.load.binary Q:\G3\g3-master\build\g3_fpga\release\fip.bin 0x8000000 /verify
;d.load.binary  Q:\G3\g3-master\build\g3_fpga\release\bl1.bin 0xfffc0000
;d.load.binary Q:\TZ_images\fip.bin 0x8000000 /verify
;d.load.binary Q:\TZ_images\bl1.bin 0xfffc0000 /verify
;d.load.elf  Q:\G3\g3-master\build\g3_fpga\release\bl1\bl1.elf /nocode /strippart "/space/" /path "Q:\"
;d.load.binary D:\home\jason\G3_FPGA\nop.bin 0xfffc0000
;R.S PC 0xfffc0000
;d.load.elf C:\Users\pengpeng.chen\Desktop\Jason_ASICchip\bl2.elf /strippart "/space/" /path "C:\"
d.load.binary C:\Users\pengpeng.chen\Desktop\Jason_ASICchip\bl2_ddr4.bin 0xC0018000 /verify
R.S PC 0xC0018000
;d.load.elf P:\Work\G3\ATF\g3_atf_asic\build\g3_fpga\release\bl2\bl2.elf /strippart "/space/" /path "P:\"
; reset flash controller
data.set 0xf4320004 %l 0x00304000
data.set 0xf4320004 %l 0x00300000

; U-Boot
;d.load.binary  P:\Work\G3_Master\G3-160224\build_dir\target-aarch64-openwrt-linux-gnu\linux-g3_fpga\ca-u-boot\u-boot.bin 0x4000000 /verify
;d.load.elf P:\Work\G3_Master\G3-160224\build_dir\target-aarch64-openwrt-linux-gnu\linux-g3_fpga\ca-u-boot\u-boot.sym /nocode /strippart "/space/" /path "P:\"
;d.load.binary Q:\G3\g3_u-boot\u-boot.bin 0x4000000 /verify
;d.load.elf  Q:\G3\g3_u-boot\u-boot.sym  /nocode /strippart "/space/" /path "Q:\"
;d.load.binary  P:\Work\G3_Master\G3-160525\build_dir\target-aarch64-openwrt-linux-gnu\linux-g3_fpga\u-boot-2015.04\u-boot.bin 0x4000000 /verify
;d.load.elf  P:\Work\G3_Master\G3-160525\build_dir\target-aarch64-openwrt-linux-gnu\linux-g3_fpga\u-boot-2015.04\u-boot.sym  /nocode /strippart "/space/" /path "P:\"
;d.load.binary Q:\G3\g3-otp\build\g3_fpga\release\fip.bin 0x6000000 /verify
;R.S PC 0x4000000
;d.load.elf P:\Work\G3\ATF\arm-trusted-firmware\build\g3\release\bl2\bl2.elf /strippart "/space/Work/G3/ATF/" /path "p:\"
;d.load.elf P:\Work\G3\ATF\test\build\g3\release\bl2\bl2.elf /strippart "/space/Work/G3/ATF/" /path "p:\"

; Load kernel image
;d.load.binary P:\Work\G3_Master\G3-FPGA-150629\build_dir\target-aarch64-openwrt-linux-gnu\linux-g3_fpga\linux-3.18\arch\arm64\boot\Image 0x80000
;data.load.elf P:\Work\G3_Master\G3-FPGA-150629\build_dir\target-aarch64-openwrt-linux-gnu\linux-g3_fpga\linux-3.18\vmlinux /nocode /strippart "/space/Work/G3_Master/G3-FPGA-150629/build_dir/target-aarch64-openwrt-linux-gnu/linux-g3_fpga/" /path "p:\"
;d.load.binary P:\Work\G3_Master\G3-FPGA-150629\build_dir\target-aarch64-openwrt-linux-gnu\linux-g3_fpga\linux-3.18\arch\arm64\boot\dts\cortina\ca7774-fpgaboard.dtb 0x1000000
;R.S X0 0x1000000
;R.S PC 0x80000


&uart_base=0xf4329148
;data.set &uart_base      %l 0x01B200e3		; Enable UART0,RX,TX,baudrate to 115200. Assume per_clk=50MHz
data.set 0xf4329148      %l 0x00043de3		; Enable UART0,RX,TX,baudrate to 115200. Assume per_clk=125MHz
data.set 0xf432914c %l 0x588	; FC
data.set 0xf4329150 %l 0x6c		; Sample rate
data.set 0xf4329158 %l 0x4F		; print 'O'
data.set 0xf4329158 %l 0x4B		; print 'K'
data.set 0xf4329158 %l 0x21		; print '!'
data.set 0xf4329158 %l 0x0D		;
data.set 0xf4329158 %l 0x0A		;

; Global cpll1, epll 
data.set 0xf4320164 %l 0x9425f;
data.set 0xf432016c %l 0x9425f;

; Sflash dual data line
;D.S ZSD:0xF4324030 %LE %Long 0x41000000
;D.S ZSD:0xF4324030 %LE %Long 0x87ffff3b

; Sflash quad data line
;D.S ZSD:0xF4324030 %LE %Long 0x81000000
;D.S ZSD:0xF4324030 %LE %Long 0x87ffff6b

ENDDO

